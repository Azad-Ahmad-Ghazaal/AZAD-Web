## MUAG/buildroot-external/Config.in
```kconfig
menu "MUAG Project"

config BR2_PACKAGE_MUAG_BASE
	bool "MUAG base system"
	default y

source "$BR2_EXTERNAL_MUAG_PATH/package/Config.in"

endmenu
```

## MUAG/buildroot-external/configs/muag_x86_64_defconfig
```kconfig
BR2_x86_64=y
BR2_x86_generic=y
BR2_TOOLCHAIN_BUILDROOT_MUSL=y
BR2_INIT_BUSYBOX=y
BR2_TARGET_GENERIC_HOSTNAME="muag"
BR2_TARGET_GENERIC_ISSUE="MUAG Project - lightweight x86_64 Chromebook OS"
BR2_TARGET_GENERIC_GETTY_PORT="tty1"
BR2_TARGET_GENERIC_GETTY_BAUDRATE_0="115200"
BR2_SYSTEM_DHCP="eth0"
BR2_ROOTFS_OVERLAY="$(BR2_EXTERNAL_MUAG_PATH)/board/muag/rootfs-overlay"
BR2_ROOTFS_POST_BUILD_SCRIPT="$(BR2_EXTERNAL_MUAG_PATH)/board/muag/post-build.sh"

BR2_LINUX_KERNEL=y
BR2_KERNEL_HEADERS_AS_KERNEL=y
BR2_LINUX_KERNEL_CUSTOM_VERSION=y
BR2_LINUX_KERNEL_CUSTOM_VERSION_VALUE="6.12.48"
BR2_LINUX_KERNEL_USE_ARCH_DEFAULT_CONFIG=y
BR2_LINUX_KERNEL_BZIMAGE=y

BR2_PACKAGE_BUSYBOX_SHOW_OTHERS=y
BR2_PACKAGE_LINUX_FIRMWARE=y
BR2_PACKAGE_LINUX_FIRMWARE_INTEL_WIFI=y
BR2_PACKAGE_LINUX_FIRMWARE_ATHEROS=y
BR2_PACKAGE_LINUX_FIRMWARE_RTLWIFI=y
BR2_PACKAGE_IWD=y
BR2_PACKAGE_BLUEZ5_UTILS=y
BR2_PACKAGE_ALSA_LIB=y
BR2_PACKAGE_ALSA_UTILS=y
BR2_PACKAGE_ALSA_UTILS_ALSARECORD=y
BR2_PACKAGE_ALSA_UTILS_APLAY=y
BR2_PACKAGE_V4L2_UTILS=y
BR2_PACKAGE_EVTEST=y
BR2_PACKAGE_LIBINPUT=y

BR2_PACKAGE_XORG7=y
BR2_PACKAGE_XSERVER_XORG_SERVER=y
BR2_PACKAGE_XAPP_XINIT=y
BR2_PACKAGE_OPENBOX=y
BR2_PACKAGE_XTERM=y

BR2_PACKAGE_PYTHON3=y
BR2_PACKAGE_MUAG_SHELL=y
BR2_PACKAGE_MUAG_AZAD=y
BR2_PACKAGE_MUAG_WHISPER=y

BR2_TARGET_SYSLINUX=y
BR2_TARGET_SYSLINUX_ISOLINUX=y
BR2_TARGET_ROOTFS_ISO9660=y
BR2_TARGET_ROOTFS_ISO9660_ISOLINUX=y
BR2_TARGET_ROOTFS_ISO9660_HYBRID=y
BR2_TARGET_ROOTFS_ISO9660_INITRD=y
BR2_TARGET_GENERIC_REMOUNT_ROOTFS_RW=y
```

## MUAG/buildroot-external/package/Config.in
```kconfig
menu "MUAG Project"

source "$BR2_EXTERNAL_MUAG_PATH/package/muag-shell/Config.in"

endmenu

source "$(BR2_EXTERNAL_MUAG_PATH)/package/muag-azad/Config.in"
```

## MUAG/buildroot-external/package/muag-azad/Config.in
```kconfig
config BR2_PACKAGE_MUAG_AZAD
    bool "MUAG AZAD runtime"
    depends on BR2_PACKAGE_PYTHON3
    help
      Bundles the AZAD assistant runtime and MUAG action bridge.
```

## MUAG/buildroot-external/package/muag-shell/Config.in
```kconfig
config BR2_PACKAGE_MUAG_SHELL
	bool "MUAG graphical shell"
	depends on BR2_PACKAGE_PYTHON3
	help
	  Install the MUAG graphical shell prototype.
```

## MUAG/buildroot-external/package/muag-whisper/Config.in
```kconfig
config BR2_PACKAGE_MUAG_WHISPER
    bool "MUAG offline Whisper STT"
    depends on BR2_PACKAGE_HOST_CMAKE
    help
      Builds whisper.cpp for local x86_64 speech-to-text.
      Model files are kept outside the OS image so the base image stays small.
```
